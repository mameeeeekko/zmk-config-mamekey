#include "mamekey.dtsi"

    &kscan0 {
        gpios
          = <&xiao_d 2 GPIO_ACTIVE_HIGH>
          , <&xiao_d 3 GPIO_ACTIVE_HIGH>
          , <&xiao_d 4 GPIO_ACTIVE_HIGH>
          , <&xiao_d 5 GPIO_ACTIVE_HIGH>
          , <&xiao_d 6 GPIO_ACTIVE_HIGH>
          , <&xiao_d 7 GPIO_ACTIVE_HIGH>
          , <&xiao_d 8 GPIO_ACTIVE_HIGH>
          , <&gpio0 10 GPIO_ACTIVE_HIGH>
          ; 
};

    encoder: encoder {
        compatible = "alps,ec11";
        a-gpios = <&xiao_d 10 (GPIO_ACTIVE_HIGH | GPIO_PULL_UP)>;
        b-gpios = <&xiao_d 9 (GPIO_ACTIVE_HIGH | GPIO_PULL_UP)>;
        steps = <12>;
        status = "okay";
    };
    
    sensors: sensors {
        compatible = "zmk,keymap-sensors";
        sensors = <&encoder>;
        triggers-per-rotation = <12>;
    };

&xiao_serial { status = "disabled"; };